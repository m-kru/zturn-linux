## br/package/examples/Config.in
```kconfig
config BR2_PACKAGE_EXAMPLES
	bool "examples"
	default y
	help
	  The package contains various Linux on Zynq examples.

	  https://github.com/m-kru/zturn-linux

if BR2_PACKAGE_EXAMPLES
	config BR2_PACKAGE_EXAMPLES_UIO
		bool "uio"
		default y
		help
		  Simple uio (User IO) example with generic kernel driver.

	config BR2_PACKAGE_EXAMPLES_GPIO
		bool "gpio app"
		default y
		help
		  User space application for controlling custom GPIO module.

	config BR2_PACKAGE_EXAMPLES_TIMER_IRQ
		bool "timer-irq app"
		default y
		help
		  User space application for presenting polling.
endif
```

## fw/examples/Config.in
```kconfig
config BR2_PACKAGE_EXAMPLES
	bool "examples"
	default y
	help
	  The package contains various Linux on Zynq examples.

	  https://github.com/m-kru/zturn-linux

if BR2_PACKAGE_EXAMPLES
	config BR2_PACKAGE_EXAMPLES_GPIO
		bool "gpio"
		default y
		help
		  Custom GPIO example.

	if BR2_PACKAGE_EXAMPLES_GPIO
		config BR2_PACKAGE_EXAMPLES_GPIO_APP
			bool "app"
			default y
			help
			  User space application for controlling custom GPIO module.

		config BR2_PACKAGE_EXAMPLES_GPIO_DRIVER
			bool "driver"
			default y
			depends on BR2_LINUX_KERNEL
			help
			  Kernel driver for custom GPIO module.

		comment "kernel driver requires the Linux kernel to be built"
			depends on !BR2_LINUX_KERNEL
	endif

	config BR2_PACKAGE_EXAMPLES_TIMER_IRQ
		bool "timer-irq"
		default y
		help
		  Custom timer with interrupt and user space polling with event file descriptor.

	if BR2_PACKAGE_EXAMPLES_TIMER_IRQ
		config BR2_PACKAGE_EXAMPLES_TIMER_IRQ_APP
			bool "app"
			default y
			help
			  User space application for presenting polling.

		config BR2_PACKAGE_EXAMPLES_TIMER_IRQ_DRIVER
			bool "driver"
			default y
			depends on BR2_LINUX_KERNEL
			help
			  Kernel driver for custom timer with interrupt.

		comment "kernel driver requires the Linux kernel to be built"
			depends on !BR2_LINUX_KERNEL
	endif
endif
```

## fw/examples/drivers/Kconfig
```kconfig
menu "Zturn"

config ZTURN_EXAMPLES_GPIO
	bool "Example GPIO"
	default y

config ZTURN_EXAMPLES_TIMER_IRQ
	bool "Example timer irq"
	default y

endmenu
```

## fw/zturn-gpio/Config.in
```kconfig
config BR2_PACKAGE_ZTURN_GPIO
	bool "zturn-gpio"
	help
	  The package contains a custom GPIO example.
	  It consits of the kernel driver and user space application.

	  https://github.com/m-kru/zturn-linux

if BR2_PACKAGE_ZTURN_GPIO

config BR2_PACKAGE_ZTURN_GPIO_APP
	bool "zturn custom gpio app"
	default y
	help
	  User space application for controlling custom GPIO module.

config BR2_PACKAGE_ZTURN_GPIO_DRIVER
	bool "zturn custom gpio driver"
	depends on BR2_LINUX_KERNEL
	help
	  Kernel driver for custom GPIO module.

comment "kernel driver requires the Linux kernel to be built"
	depends on !BR2_LINUX_KERNEL

endif
```

## fw/zturn/Config.in
```kconfig
config BR2_PACKAGE_ZTURN
	bool "zturn"
	default y
	help
	  The package contains Z-Turn examples.

	  https://github.com/m-kru/zturn-linux

if BR2_PACKAGE_ZTURN
	config BR2_PACKAGE_ZTURN_GPIO
		bool "zturn-gpio"
		default y
		help
		  Custom GPIO example.

	if BR2_PACKAGE_ZTURN_GPIO
		config BR2_PACKAGE_ZTURN_GPIO_APP
			bool "gpio app"
			default y
			help
			  User space application for controlling custom GPIO module.

		config BR2_PACKAGE_ZTURN_GPIO_DRIVER
			bool "gpio driver"
			default y
			depends on BR2_LINUX_KERNEL
			help
			  Kernel driver for custom GPIO module.

		comment "kernel driver requires the Linux kernel to be built"
			depends on !BR2_LINUX_KERNEL
	endif
endif
```
